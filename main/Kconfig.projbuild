## main/Kconfig.projbuild
```kconfig
menu "ESP32 MIDI Options"
    config MIDI_MAX_EVENTS
        int "Maximum number of MIDI events"
        default 1024
        help
            Limit for statically allocated MIDI event buffer.

    config UPLOAD_BUF_SIZE
        int "Upload buffer size (bytes)"
        default 4096
        help
            Chunk size for file and OTA uploads.
endmenu
```

## sdkconfig.defaults
```kconfig
CONFIG_PARTITION_TABLE_CUSTOM=y
CONFIG_PARTITION_TABLE_CUSTOM_FILENAME="partitions.csv"
CONFIG_PARTITION_TABLE_OFFSET=0x8000
CONFIG_ESP32_SPIRAM_SUPPORT=n
CONFIG_MIDI_MAX_EVENTS=1024
CONFIG_UPLOAD_BUF_SIZE=4096
```
